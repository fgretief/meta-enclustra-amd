## meta-enclustra-lab/conf/layer.conf
```bitbake
BBPATH .= ":${LAYERDIR}"

BBFILES += " \
${LAYERDIR}/recipes-*/*/*.bb \
${LAYERDIR}/recipes-*/*/*.bbappend \
"

BBFILES_DYNAMIC += " \
    petalinux:${LAYERDIR}/dynamic-layers/meta-petalinux/recipes-*/*/*.bbappend \
"

BBFILE_COLLECTIONS += "enclustra-lab"
BBFILE_PATTERN_enclustra-lab = "^${LAYERDIR}/"
BBFILE_PRIORITY_enclustra-lab = "20"
BBFILE_PATTERN_IGNORE_EMPTY_enclustra-lab = "1"
LAYERVERSION = "1"
LAYERSERIES_COMPAT_enclustra-lab = "kirkstone langdale scarthgap"
```

## meta-enclustra-refdes/conf/layer.conf
```bitbake
BBPATH .= ":${LAYERDIR}"

BBFILES += " \
${LAYERDIR}/recipes-*/*/*.bb \
${LAYERDIR}/recipes-*/*/*.bbappend \
"

BBFILES_DYNAMIC += " \
    petalinux:${LAYERDIR}/dynamic-layers/meta-petalinux/recipes-*/*/*.bbappend \
"

BBFILE_COLLECTIONS += "enclustra-refdes"
BBFILE_PATTERN_enclustra-refdes = "^${LAYERDIR}/"
BBFILE_PRIORITY_enclustra-refdes = "20"
BBFILE_PATTERN_IGNORE_EMPTY_enclustra-refdes = "1"
LAYERVERSION = "1"
LAYERSERIES_COMPAT_enclustra-refdes = "scarthgap"
```
